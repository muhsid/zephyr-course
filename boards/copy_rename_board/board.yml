## boards/copy_rename_board/board.yml
```yaml
board:
  name: copy_rename_board
  full_name: copy_rename_board_test
  vendor: irtiza
  socs:
  - name: mcxn236
```

## boards/scratch_board/Kconfig
```kconfig
config BOARD_SCRATCH_BOARD
	select BOARD_EARLY_INIT_HOOK
	select BOARD_LATE_INIT_HOOK
```

## boards/scratch_board/board.yml
```yaml
board:
  name: scratch_board
  full_name: scratch_board_test
  vendor: irtiza
  socs:
  - name: mcxn236
```

## boards/scratch_board/scratch_board_defconfig
```kconfig
CONFIG_SERIAL=y
CONFIG_CONSOLE=y
CONFIG_UART_CONSOLE=y
CONFIG_TRUSTED_EXECUTION_SECURE=y
```
