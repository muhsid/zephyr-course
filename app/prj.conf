## Kconfig
```
menuconfig LED_SUBSYSTEM
	bool "LED Subsystem"
	default y

config APP_HEARTBEAT_PERIOD_MS
	int "App heartbeat period (ms)"
	default 500
	range 100 2000
	depends on LED_SUBSYSTEM
	help
	  How long the application heartbeat period should be, in milliseconds.

menuconfig LED_ADVANCED
	bool "Advanced LED settings"
	depends on LED_SUBSYSTEM

config LED_BRIGHTNESS
	int "LED brightness (0-100)"
	default 100
	range 0 100
	depends on LED_ADVANCED

config LED_FADE_DURATION_MS
	int "LED fade duration (ms)"
	default 500
	range 0 10000
	depends on LED_ADVANCED

menu "Expert settings"
	depends on LED_ADVANCED

config LED_DEBUG
	bool "Enable LED debugging"

config LED_CUSTOM_PATTERN
	bool "Custom blink pattern"

endmenu

source "Kconfig.zephyr"
```

## prj.conf
```kconfig
CONFIG_GPIO=y
CONFIG_LOG=y
CONFIG_LED_SUBSYSTEM=y
```

## src/main.cpp
```c
#include <zephyr/drivers/gpio.h>
#include <zephyr/kernel.h>
#include <zephyr/logging/log.h>



/* The devicetree node identifier for the "app-led" alias. */
#define LED_NODE DT_ALIAS(app_led)

static const struct gpio_dt_spec led = GPIO_DT_SPEC_GET(LED_NODE, gpios);

LOG_MODULE_REGISTER(main, LOG_LEVEL_INF);

int main(void)
{
#ifdef CONFIG_LED_SUBSYSTEM
    bool led_state = true;

    if (!gpio_is_ready_dt(&led)) return 0;

    if (gpio_pin_configure_dt(&led, GPIO_OUTPUT_ACTIVE) < 0) return 0;
#ifdef CONFIG_LED_ADVANCED
    LOG_INF("Brightness: %d%%, fade: %d ms",
            CONFIG_LED_BRIGHTNESS, CONFIG_LED_FADE_DURATION_MS);
#endif
static const int pattern[] = {100, 100, 100, 600};
size_t step = 0;

    while (1) {
        if (gpio_pin_toggle_dt(&led) < 0) return 0;

        led_state = !led_state;
        if (IS_ENABLED(CONFIG_LED_DEBUG)) {
    		LOG_INF("LED state: %s", led_state ? "ON" : "OFF");
		}

        if (IS_ENABLED(CONFIG_LED_CUSTOM_PATTERN)) {
    		k_msleep(pattern[step]);
    		step = (step + 1) % ARRAY_SIZE(pattern);
		} 
		else {
    		k_msleep(CONFIG_APP_HEARTBEAT_PERIOD_MS);
		}

    }
#else
    LOG_INF("LED Subsystem is disabled");
#endif

	return 0;

}
```
